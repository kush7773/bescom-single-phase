## espidf_ccms_fleet_1p2w_v1/main/Kconfig.projbuild
```kconfig
menu "CCMS Device Settings"

config DEVICE_IMEI
    string "Device IMEI (15 digits)"
    default "123456789012345"
    help
        IMEI used as SerialNumber during fleet provisioning and as MQTT client ID.

config CCMS_WIFI_SSID
    string "Wi-Fi SSID"
    default "YOUR_WIFI_SSID"
    help
        Station-mode SSID used to connect before fleet provisioning.

config CCMS_WIFI_PASSWORD
    string "Wi-Fi Password"
    default "YOUR_WIFI_PASSWORD"
    help
        Station-mode password used to connect before fleet provisioning.

config CCMS_WIFI_MAX_RETRY
    int "Wi-Fi max retry count"
    range 1 100
    default 20
    help
        Maximum reconnection attempts before failing boot.

endmenu
```

## espidf_ccms_fleet_3p4w_v81/main/Kconfig.projbuild
```kconfig
menu "CCMS Device Settings"

config DEVICE_IMEI
    string "Device IMEI (15 digits)"
    default "123456789012345"
    help
        IMEI used as SerialNumber during fleet provisioning and as MQTT client ID.

config CCMS_WIFI_SSID
    string "Wi-Fi SSID"
    default "YOUR_WIFI_SSID"
    help
        Station-mode SSID used to connect before fleet provisioning.

config CCMS_WIFI_PASSWORD
    string "Wi-Fi Password"
    default "YOUR_WIFI_PASSWORD"
    help
        Station-mode password used to connect before fleet provisioning.

config CCMS_WIFI_MAX_RETRY
    int "Wi-Fi max retry count"
    range 1 100
    default 20
    help
        Maximum reconnection attempts before failing boot.

config CCMS_NSL
    int "Number of Street Lights (total installed)"
    range 0 10000
    default 0
    help
        Total number of street lights installed on this feeder.
        Reported in telemetry as nsl. Set 0 if unknown.

config CCMS_NWSL
    int "Number of Working Street Lights (NWSL)"
    range 0 10000
    default 0
    help
        Number of street lights expected to be ON when relay is closed.
        Used with LAMP_CURRENT_MA to estimate lights ON.
        Set 0 to disable lamp-count fault detection.

config CCMS_LAMP_CURRENT_MA
    int "Rated current per lamp (milliamps)"
    range 0 5000
    default 500
    help
        Rated AC current drawn by one street light lamp in milliamps.
        Example: 9W LED on 230V = ~40 mA; 70W HPS = ~350 mA.
        num_lights_on = round(measured_current_A / (LAMP_CURRENT_MA/1000)).

config FIRMWARE_VERSION
    string "Firmware version string"
    default "8.1"
    help
        Version reported in telemetry and checked during OTA to skip
        redundant flashing. Format: major.minor (e.g. 8.1, 9.0).

endmenu
```

## sdkconfig.defaults
```kconfig
# Custom partition table — required for OTA + binary > 1 MB
CONFIG_PARTITION_TABLE_CUSTOM=y
CONFIG_PARTITION_TABLE_CUSTOM_FILENAME="partitions.csv"
CONFIG_PARTITION_TABLE_OFFSET=0x8000

# Flash size must match your hardware (ESP32 modules typically 4 MB)
CONFIG_ESPTOOLPY_FLASHSIZE_4MB=y
CONFIG_ESPTOOLPY_FLASHSIZE="4MB"
```
